#define    GLCD_DATABUS         PORTA
#define    GLCD_CONTROL         PORTF
// #define    GLCD_CONTROL_RS      0
// #define    GLCD_CONTROL_RW      1
// #define    GLCD_CONTROL_EN      2
// #define    GLCD_CONTROL_CS1     3
// #define    GLCD_CONTROL_CS2     4
// #define    GLCD_CONTROL_RSTB    5

unsigned char glcd_char_xpos, glcd_char_ypos;
unsigned char Cursor = 0, X_Cursor, Y_Cursor;

void glcd_inst(unsigned char Inst, unsigned char Data) {
	GLCD_CONTROL = Inst & 0x38;         // RS 0, E 0
	_delay_us(10);
	GLCD_DATABUS = Data;
	GLCD_CONTROL = (Inst & 0x38) | 0x04;    // RS 0, E 1
	_delay_us(10);
	GLCD_CONTROL = Inst & 0x38;         // RS 0, E 0
	GLCD_CONTROL = 0x20;            // All Clear
	_delay_us(100);
}

void glcd_data(unsigned char Inst, unsigned char Data) {
	GLCD_CONTROL = (Inst & 0x38) | 0x01;    // RS 1, E 0
	_delay_us(10);
	GLCD_DATABUS = Data;
	GLCD_CONTROL = (Inst & 0x38) | 0x05;    // RS 1, E 1
	_delay_us(10);
	GLCD_CONTROL = (Inst & 0x38) | 0x01;    // RS 1, E 0
	GLCD_CONTROL = 0x20;            // All Clear
	_delay_us(100);
}

void glcd_init(void) {
	unsigned char i, j, k;

	GLCD_CONTROL = 0x00;         // All Clear
	glcd_inst(0x38, 0x3F);    // CS1, CS2 Display On
	glcd_inst(0x38, 0xC0);    // CS1, CS2 Display Position

	k = 0xB8;
	for(i=0; i<8; i++) {
		glcd_inst(0x38, k);       // X Start Address
		glcd_inst(0x38, 0x40);    // Y Start Address
		for(j=0; j<64; j++)
		glcd_data(0x38, 0x00);       // Clear CS1, CS2
		k++;
	}
}

/* 5x7 ASCII Character Font */
const unsigned char glcd__ascii_font_array[95][5] = {
	{0x00, 0x00, 0x00, 0x00, 0x00},    // 0x20 Space
	{0x00, 0x00, 0x4F, 0x00, 0x00},    // 0x21 !
	{0x00, 0x07, 0x00, 0x07, 0x00},    // 0x22 "
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	{0x08, 0x04, 0x08, 0x10, 0x08}     // 0x7E ~
};

void glcd_char_xypos(unsigned char X, unsigned char Y) {
	glcd_char_xpos = X;    glcd_char_ypos = Y;
	
	glcd_inst(0x38, 0xB8 + glcd_char_xpos);

	// CS1 1, CS2 0
	if(glcd_char_ypos <= 9)    glcd_inst(0x28, 0x40 + glcd_char_ypos * 6 + 4);
	// CS1 0, CS2 1
	else           glcd_inst(0x30, 0x40 + (glcd_char_ypos - 10) * 6);
}

void glcd_char(unsigned char Data) {
	unsigned char i, Inst, Font_Data;

	glcd_char_xypos(glcd_char_xpos, glcd_char_ypos);
	if(glcd_char_ypos <= 9)    Inst = 0x28;
	else           Inst = 0x30;
	for(i=0; i<=4; i++) {
		Font_Data = glcd__ascii_font_array[Data - 0x20][i];
		if((Cursor == 1) && (glcd_char_xpos == X_Cursor) && (glcd_char_ypos == Y_Cursor))
		glcd_data(Inst, Font_Data | 0x80);
		else
		glcd_data(Inst, Font_Data);
	}
	glcd_data(Inst, 0x00);    glcd_char_ypos++;
	if(glcd_char_ypos == 20) { glcd_char_ypos = 0; glcd_char_xpos++; }
}

void glcd_str(unsigned char X, unsigned char Y, unsigned char *Str) {
	glcd_char_xpos = X;    glcd_char_ypos = Y;
	while(*Str != '\0') {
		glcd_char(*Str);
		Str++;
	}
}

void glcd_cls(void) {
	glcd_init();
}

void glcd_draw(unsigned char *bitmapData) {
	unsigned char i, j, k;
	unsigned int l;

	k = 0xB8;
	l = 0;
	for(i=0; i<8; i++) {
		glcd_inst(0x38, k);
		glcd_inst(0x28, 0x40);
		for(j=0; j<64; j++)
		glcd_data(0x28, bitmapData[l++]);
		glcd_inst(0x30, 0x40);
		for(j=64; j<128; j++)
		glcd_data(0x30, bitmapData[l++]);
		k++;
	}
}